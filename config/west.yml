## config/west.yml
```yaml
manifest:
  remotes:
    - name: zmkfirmware
      url-base: https://github.com/zmkfirmware
    # Additional modules containing boards/shields/custom code can be listed here as well
  projects:
    - name: zmk
      remote: zmkfirmware
      # The nice_duck_view widget uses LVGL 9 / current ZMK APIs, so we must
      # track main. This must stay in sync with .github/workflows/build.yml.
      revision: main
      import: app/west.yml
  self:
    path: config
```
